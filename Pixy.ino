/////////////////////////////////////////////////////////////////////////////////////////////////////////////////////////////
// Project: Pixy                                                                                                           //
// Author: Jeffrey Bednar                                                                                                  //
// Copyright (c) Illusion Interactive, 2011 - 2026.                                                                        //
/////////////////////////////////////////////////////////////////////////////////////////////////////////////////////////////
// Educational Use Notice:                                                                                                 //
/////////////////////////////////////////////////////////////////////////////////////////////////////////////////////////////
// This project is provided for educational and learning purposes only. You are welcome to read, study, and experiment     //
// with this software and/or hardware. It is not intended for commercial use. This software and/or hardware is provided    //
// "as is", without warranty of any kind. The author assumes no responsibility for any damages or issues resulting from    //
// its use.                                                                                                                //
/////////////////////////////////////////////////////////////////////////////////////////////////////////////////////////////
// Date: Tuesday, July 21st, 2026
// Description: Lumenary pixel test for RGB LED's using MCU PWM and software PWM control.
/////////////////////////////////////////////////////////////////////////////////////////////////////////////////////////////
// Fold all: Ctrl + K + 0
// Unfold all: Ctrl + K + J
// Show file explorer: Ctrl + Shift + E
// Auto format: Ctrl + T
/////////////////////////////////////////////////////////////////////////////////////////////////////////////////////////////
#include "Headers/common.h"
#include "Headers/gamma.h"
#include "Headers/pwm.h"
/////////////////////////////////////////////////////////////////////////////////////////////////////////////////////////////
#define NAMEOF(x) #x
/////////////////////////////////////////////////////////////////////////////////////////////////////////////////////////////
// Program constants:
/////////////////////////////////////////////////////////////////////////////////////////////////////////////////////////////
const uint8_t FW_VERSION_MAJOR = 1;
const uint8_t FW_VERSION_MINOR = 0;
const uint8_t FW_VERSION_PATCH = 0;
/////////////////////////////////////////////////////////////////////////////////////////////////////////////////////////////
const uint8_t SERIAL_OUT = true;
const uint8_t PIN_OUTPUT_LED_R = 2;
const uint8_t PIN_OUTPUT_LED_G = 3;
const uint8_t PIN_OUTPUT_LED_B = 4;
/////////////////////////////////////////////////////////////////////////////////////////////////////////////////////////////
const uint8_t RANDOM_BLEND_LOWERBOUND = 1;  // Increase/decrease by a random amount for each PWM cycle.
const uint8_t RANDOM_BLEND_UPPERBOUND = 20;
/////////////////////////////////////////////////////////////////////////////////////////////////////////////////////////////
// Types:
/////////////////////////////////////////////////////////////////////////////////////////////////////////////////////////////
typedef enum CHANNEL : uint8_t {
  CHANNEL_RED,
  CHANNEL_GREEN,
  CHANNEL_BLUE,
  CHANNEL_COUNT  // Must be last; for iterating/bounds.
} CHANNEL_T;
/////////////////////////////////////////////////////////////////////////////////////////////////////////////////////////////
typedef enum CHANNEL_STATE : uint8_t {
  CHANNEL_STATE_RISING,
  CHANNEL_STATE_FALLING,
  CHANNEL_STATE_COUNT  // Must be last; for iterating/bounds.
} CHANNEL_STATE_T;
/////////////////////////////////////////////////////////////////////////////////////////////////////////////////////////////
// Initial setup.
/////////////////////////////////////////////////////////////////////////////////////////////////////////////////////////////
void setup(void) {
  ///////////////////////////////////////////////////////////////////////////////////////////////////////////////////////////
  // Hard delay in case of DC power chatter or rapid connect/disconnect of power.
  ///////////////////////////////////////////////////////////////////////////////////////////////////////////////////////////
  delay(3000);
  ///////////////////////////////////////////////////////////////////////////////////////////////////////////////////////////
  setupSeed();
  ///////////////////////////////////////////////////////////////////////////////////////////////////////////////////////////
  softwarePwmBegin();
  ///////////////////////////////////////////////////////////////////////////////////////////////////////////////////////////
  if (SERIAL_OUT) {
    Serial.begin(9600);
    delayInternalSeconds(1, interruptHandler);
    serialWrite(__func__, "=================");
    serialWrite(__func__, "== New Session ==");
    serialWrite(__func__, "=================");
  }
}
/////////////////////////////////////////////////////////////////////////////////////////////////////////////////////////////
// Main program loop.
/////////////////////////////////////////////////////////////////////////////////////////////////////////////////////////////
void loop(void) {
  //*
  blendPwmTest();
  delayInternalMilliseconds(25, interruptHandler);
  //*/
  ///////////////////////////////////////////////////////////////////////////////////////////////////////////////////////////
  /*
  softwarePwmTest(1000);
  delayInternalSeconds(1, interruptHandler);
  //*/
}
/////////////////////////////////////////////////////////////////////////////////////////////////////////////////////////////
// Gamma corrected blend test for each channel.
/////////////////////////////////////////////////////////////////////////////////////////////////////////////////////////////
void blendPwmTest(void) {
  static CHANNEL_T eChannelR = CHANNEL_RED,
                   eChannelG = CHANNEL_GREEN,
                   eChannelB = CHANNEL_BLUE;
  ///////////////////////////////////////////////////////////////////////////////////////////////////////////////////////////
  static uint8_t ubChannelRPwm = (uint8_t)random(0, UINT8_MAX + 1),
                 ubChannelGPwm = (uint8_t)random(0, UINT8_MAX + 1),
                 ubChannelBPwm = (uint8_t)random(0, UINT8_MAX + 1);
  ///////////////////////////////////////////////////////////////////////////////////////////////////////////////////////////
  static CHANNEL_STATE_T eChannelRState = (CHANNEL_STATE_T)random(CHANNEL_STATE_COUNT),
                         eChannelGState = (CHANNEL_STATE_T)random(CHANNEL_STATE_COUNT),
                         eChannelBState = (CHANNEL_STATE_T)random(CHANNEL_STATE_COUNT);
  ///////////////////////////////////////////////////////////////////////////////////////////////////////////////////////////
  handleBlendChannel(&eChannelR, &eChannelRState, &ubChannelRPwm);
  handleBlendChannel(&eChannelG, &eChannelGState, &ubChannelGPwm);
  handleBlendChannel(&eChannelB, &eChannelBState, &ubChannelBPwm);
}
/////////////////////////////////////////////////////////////////////////////////////////////////////////////////////////////
void handleBlendChannel(CHANNEL_T* const p_eChannel, CHANNEL_STATE_T* const p_eChannelState, uint8_t* const p_ubChannelPwm) {
  if (*p_eChannelState == CHANNEL_STATE_RISING) {
    softwarePwmAnalogWrite(getPinForChannel(*p_eChannel), getGammaCorrectnessForChannel(*p_eChannel, *p_ubChannelPwm));
    /////////////////////////////////////////////////////////////////////////////////////////////////////////////////////////
    if (*p_ubChannelPwm >= UINT8_MAX) {
      *p_eChannelState = CHANNEL_STATE_FALLING;
    } else {
      uint8_t ubIncrease = (uint8_t)random(RANDOM_BLEND_LOWERBOUND, RANDOM_BLEND_UPPERBOUND + 1);
      if (*p_ubChannelPwm <= (UINT8_MAX - ubIncrease)) {
        *p_ubChannelPwm += ubIncrease;
      } else {
        *p_ubChannelPwm = UINT8_MAX;
      }
    }
  } else {
    softwarePwmAnalogWrite(getPinForChannel(*p_eChannel), getGammaCorrectnessForChannel(*p_eChannel, *p_ubChannelPwm));
    /////////////////////////////////////////////////////////////////////////////////////////////////////////////////////////
    if (*p_ubChannelPwm <= 0) {
      *p_eChannelState = CHANNEL_STATE_RISING;
    } else {
      uint8_t ubDecrease = (uint8_t)random(RANDOM_BLEND_LOWERBOUND, RANDOM_BLEND_UPPERBOUND + 1);
      if (*p_ubChannelPwm >= ubDecrease) {
        *p_ubChannelPwm -= ubDecrease;
      } else {
        *p_ubChannelPwm = 0;
      }
    }
  }
}
/////////////////////////////////////////////////////////////////////////////////////////////////////////////////////////////
uint8_t getGammaCorrectnessForChannel(CHANNEL_T eChannel, uint8_t ubPwm) {
  uint8_t ubGammaCorrectedPwm;

  switch (eChannel) {
    case CHANNEL_RED:
      {
        ubGammaCorrectedPwm = gammaCorrectedRed(ubPwm);
        break;
      }
    case CHANNEL_GREEN:
      {
        ubGammaCorrectedPwm = gammaCorrectedGreen(ubPwm);
        break;
      }
    case CHANNEL_BLUE:
      {
        ubGammaCorrectedPwm = gammaCorrectedBlue(ubPwm);
        break;
      }
    default:
      {
        serialWrite(__func__, "Error: Uncased channel.");
      }
  }

  return ubGammaCorrectedPwm;
}
/////////////////////////////////////////////////////////////////////////////////////////////////////////////////////////////
void serialWrite(const char* const szFunctionName, const char* const szMessage) {
  Serial.print(szFunctionName);
  Serial.print(": ");
  Serial.println(szMessage);
}
/////////////////////////////////////////////////////////////////////////////////////////////////////////////////////////////
uint8_t getPinForChannel(CHANNEL_T eChannel) {
  uint8_t ubPin;
  switch (eChannel) {
    case CHANNEL_RED:
      {
        ubPin = PIN_OUTPUT_LED_R;
        break;
      }
    case CHANNEL_GREEN:
      {
        ubPin = PIN_OUTPUT_LED_G;
        break;
      }
    case CHANNEL_BLUE:
      {
        ubPin = PIN_OUTPUT_LED_B;
        break;
      }
    default:
      {
        serialWrite(__func__, "Error: Uncased channel.");
      }
  }
  // Or return eChannel + 2.
  return ubPin;
}
/////////////////////////////////////////////////////////////////////////////////////////////////////////////////////////////
// Seed by mixing analog noise and runtime for a higher degree of entropy.
/////////////////////////////////////////////////////////////////////////////////////////////////////////////////////////////
void setupSeed(void) {
  unsigned long ulSeed = 0;

  for (uint8_t ubI = 0; ubI < 32; ubI++) {
    for (uint8_t ubPin = A0; ubPin <= A5; ubPin++) {
      ulSeed ^= analogRead(ubPin) << (ubI % 16);
    }
    ulSeed ^= micros();
    delayInternalMilliseconds(5, NULL);
  }

  randomSeed(ulSeed);
}
/////////////////////////////////////////////////////////////////////////////////////////////////////////////////////////////
// Gamma corrected fade test for each channel.
/////////////////////////////////////////////////////////////////////////////////////////////////////////////////////////////
void softwarePwmTest(uint16_t usPwmDelayUs) {
  uint16_t usI = 0;
  ///////////////////////////////////////////////////////////////////////////////////////////////////////////////////////////
  for (; usI < GAMMA_CHANNEL_MAX_VALUES; usI++) {
    softwarePwmAnalogWrite(PIN_OUTPUT_LED_R, gammaCorrectedRed(usI));
    delayInternalMicroseconds(usPwmDelayUs, interruptHandler);
  }
  for (usI = GAMMA_CHANNEL_MAX_VALUES - 1; usI > 0; usI--) {
    softwarePwmAnalogWrite(PIN_OUTPUT_LED_R, gammaCorrectedRed(usI));
    delayInternalMicroseconds(usPwmDelayUs, interruptHandler);
  }
  ///////////////////////////////////////////////////////////////////////////////////////////////////////////////////////////
  for (; usI < GAMMA_CHANNEL_MAX_VALUES; usI++) {
    softwarePwmAnalogWrite(PIN_OUTPUT_LED_G, gammaCorrectedGreen(usI));
    delayInternalMicroseconds(usPwmDelayUs, interruptHandler);
  }
  for (usI = GAMMA_CHANNEL_MAX_VALUES - 1; usI > 0; usI--) {
    softwarePwmAnalogWrite(PIN_OUTPUT_LED_G, gammaCorrectedGreen(usI));
    delayInternalMicroseconds(usPwmDelayUs, interruptHandler);
  }
  ///////////////////////////////////////////////////////////////////////////////////////////////////////////////////////////
  for (; usI < GAMMA_CHANNEL_MAX_VALUES; usI++) {
    softwarePwmAnalogWrite(PIN_OUTPUT_LED_B, gammaCorrectedBlue(usI));
    delayInternalMicroseconds(usPwmDelayUs, interruptHandler);
  }
  for (usI = GAMMA_CHANNEL_MAX_VALUES - 1; usI > 0; usI--) {
    softwarePwmAnalogWrite(PIN_OUTPUT_LED_B, gammaCorrectedBlue(usI));
    delayInternalMicroseconds(usPwmDelayUs, interruptHandler);
  }
  ///////////////////////////////////////////////////////////////////////////////////////////////////////////////////////////
  for (; usI < GAMMA_CHANNEL_MAX_VALUES; usI++) {
    softwarePwmAnalogWrite(PIN_OUTPUT_LED_R, gammaCorrectedRed(usI));
    softwarePwmAnalogWrite(PIN_OUTPUT_LED_G, gammaCorrectedGreen(usI));
    softwarePwmAnalogWrite(PIN_OUTPUT_LED_B, gammaCorrectedBlue(usI));
    delayInternalMicroseconds(usPwmDelayUs, interruptHandler);
  }
  for (usI = GAMMA_CHANNEL_MAX_VALUES - 1; usI > 0; usI--) {
    softwarePwmAnalogWrite(PIN_OUTPUT_LED_R, gammaCorrectedRed(usI));
    softwarePwmAnalogWrite(PIN_OUTPUT_LED_G, gammaCorrectedGreen(usI));
    softwarePwmAnalogWrite(PIN_OUTPUT_LED_B, gammaCorrectedBlue(usI));
    delayInternalMicroseconds(usPwmDelayUs, interruptHandler);
  }
}
/////////////////////////////////////////////////////////////////////////////////////////////////////////////////////////////
// Check on interrupts or other states while performing an internal delay. Fast code; no hard delays or waiting.
/////////////////////////////////////////////////////////////////////////////////////////////////////////////////////////////
void interruptHandler(void) {
}
/////////////////////////////////////////////////////////////////////////////////////////////////////////////////////////////
inline void red(uint8_t ubState) {
  digitalWrite(PIN_OUTPUT_LED_R, ubState);
}
/////////////////////////////////////////////////////////////////////////////////////////////////////////////////////////////
inline void green(uint8_t ubState) {
  digitalWrite(PIN_OUTPUT_LED_G, ubState);
}
/////////////////////////////////////////////////////////////////////////////////////////////////////////////////////////////
inline void blue(uint8_t ubState) {
  digitalWrite(PIN_OUTPUT_LED_B, ubState);
}
/////////////////////////////////////////////////////////////////////////////////////////////////////////////////////////////
// Internal second delay handler to check on tasks while waiting.
/////////////////////////////////////////////////////////////////////////////////////////////////////////////////////////////
void delayInternalSeconds(uint16_t usDelaySeconds, void (*p_fnInterruptHandler)(void)) {
  unsigned long ulMillisStart = millis();
  unsigned long usDelayMs = usDelaySeconds * 1000;

  if (p_fnInterruptHandler) {
    while ((millis() - ulMillisStart) < usDelayMs) {
      p_fnInterruptHandler();
    }
  } else {
    while ((millis() - ulMillisStart) < usDelayMs) {
      ;
    }
  }
}
/////////////////////////////////////////////////////////////////////////////////////////////////////////////////////////////
// Internal millisecond delay handler to check on tasks while waiting.
/////////////////////////////////////////////////////////////////////////////////////////////////////////////////////////////
void delayInternalMilliseconds(uint16_t usDelayMs, void (*p_fnInterruptHandler)(void)) {
  unsigned long ulMillisStart = millis();

  if (p_fnInterruptHandler) {
    while ((millis() - ulMillisStart) < usDelayMs) {
      p_fnInterruptHandler();
    }
  } else {
    while ((millis() - ulMillisStart) < usDelayMs) {
      ;
    }
  }
}
/////////////////////////////////////////////////////////////////////////////////////////////////////////////////////////////
// Internal microsecond delay handler to check on tasks while waiting.
/////////////////////////////////////////////////////////////////////////////////////////////////////////////////////////////
void delayInternalMicroseconds(uint16_t usDelayUs, void (*p_fnInterruptHandler)(void)) {
  unsigned long ulMicrosStart = micros();

  if (p_fnInterruptHandler) {
    while ((micros() - ulMicrosStart) < usDelayUs) {
      p_fnInterruptHandler();
    }
  } else {
    while ((micros() - ulMicrosStart) < usDelayUs) {
      ;
    }
  }
}
/////////////////////////////////////////////////////////////////////////////////////////////////////////////////////////////